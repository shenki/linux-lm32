## arch/lm32/Kconfig
```kconfig
config LM32
	bool
	default y
	select CPU_MICO32
	select HAVE_GENERIC_HARDIRQS
	select GENERIC_HARDIRQS_NO_DEPRECATED
	select GENERIC_IRQ_SHOW
	select GENERIC_CPU_DEVICES
	select ARCH_REQUIRE_GPIOLIB
	select OF
	select OF_EARLY_FLATTREE
	select HAVE_MEMBLOCK

config GENERIC_GPIO
	bool

config MMU
	bool
	default n

config NO_DMA
	bool
	default y

config VGA_CONSOLE
	bool
	default n

config ZONE_DMA_FLAG
	int
	default 0

config RWSEM_GENERIC_SPINLOCK
	bool
	default y

config GENERIC_ALLOCATOR
	bool
	default y

config GENERIC_BUG
	bool
	default y

config GENERIC_CALIBRATE_DELAY
	bool
	default y

config GENERIC_CLOCKEVENTS
	bool
	default y

config GENERIC_CSUM
	bool
	default y

config GENERIC_FIND_NEXT_BIT
	bool
	default y

config GENERIC_HWEIGHT
	bool
	default y

config SELECT_MEMORY_MODEL
	bool
	default y

config FLATMEM
	bool
	default y

config FLAT_NODE_MEM_MAP
	bool
	default y

config NO_IOPORT
	bool
	default y

config APM_EMULATION
	bool
	default n

source "init/Kconfig"

source "arch/lm32/Kconfig.cpu"

source "kernel/time/Kconfig"

source "kernel/Kconfig.hz"

source "mm/Kconfig"

menu "Executable file formats"

source "fs/Kconfig.binfmt"

endmenu

menu "Power management options"

config PM
	bool "Power Management support"
	help
	  Support processor power management modes

endmenu

source "net/Kconfig"

source "drivers/Kconfig"

source "fs/Kconfig"

source "arch/lm32/Kconfig.debug"

source "security/Kconfig"

source "crypto/Kconfig"

source "lib/Kconfig"
```

## arch/lm32/Kconfig.cpu
```kconfig
menu "Processor, Board and Features"

choice
	prompt "LM32 platform"
	default PLAT_MILKYMIST

config PLAT_MILKYMIST
	bool "milkymist"
	help
	  Milkymist SoC.

endchoice

if (PLAT_MILKYMIST)
choice
	prompt "CPU"
	default CPU_MICO32

config CPU_MICO32
	bool "mico32"
	help
	  LatticeMico32 processor.
endchoice

choice
	prompt "Board Selection"
	default BOARD_MILKYMIST_ONE

config	BOARD_MILKYMIST_ONE
	bool "Milkymist One"

config	BOARD_MILKYMIST_SOC
	bool "Milkymist SoC"
endchoice
endif

config CPU_CLOCK
	int "CPU Clock [Hz] (integer)"
	default "80000000"

config KERNEL_BASE_ADDR
	hex "Physical address where Linux Kernel is"
	default "0x40000000"
	help
	  Define where the kernel will be loaded to and executed from.

config EARLY_PRINTK
	bool "Early printk"
	default y
	help
	  This option enables special console drivers which allow the kernel
	  to print messages very early in the bootup process.

	  This is useful for kernel debugging when your machine crashes very
	  early before the console code is initialized. You should normally
	        say N here, unless you want to debug.

config LM32_HW_JTAG
bool "Disable kernel exception handling (enable JTAG debugging)"
	default n
	help
	  This option disables the exception handling within the kernel. It is
	  required to allow access with the JTAG debugger for kernel-level
	  debug access.

	  Your should normally say N here, unless you want to debug.
endmenu
```

## arch/lm32/Kconfig.debug
```kconfig
menu "Kernel hacking"

source "lib/Kconfig.debug"

config CMDLINE
	string "Default kernel command string"
	default ""

config CMDLINE_FORCE
	bool "Always use the default kernel command string"
	depends on CMDLINE != ""
	help
	  Always use the default kernel command string, even if the boot
	  loader passes other arguments to the kernel.
	  This is useful if you cannot or don't want to change the
	  command-line options your boot loader passes to the kernel.

	  If unsure, say N.

endmenu
```

## arch/lm32/defconfig
```kconfig
# CONFIG_LOCALVERSION_AUTO is not set
CONFIG_LOG_BUF_SHIFT=12
CONFIG_BLK_DEV_INITRD=y
# CONFIG_ELF_CORE is not set
# CONFIG_BASE_FULL is not set
# CONFIG_EPOLL is not set
# CONFIG_SIGNALFD is not set
# CONFIG_EVENTFD is not set
CONFIG_EMBEDDED=y
CONFIG_SLAB=y
CONFIG_MODULES=y
CONFIG_MODULE_UNLOAD=y
# CONFIG_LBDAF is not set
# CONFIG_BLK_DEV_BSG is not set
# CONFIG_IOSCHED_DEADLINE is not set
# CONFIG_IOSCHED_CFQ is not set
# CONFIG_EARLY_PRINTK is not set
# CONFIG_BINFMT_ELF_FDPIC is not set
CONFIG_BINFMT_FLAT=y
CONFIG_NET=y
CONFIG_PACKET=y
CONFIG_UNIX=y
CONFIG_NET_KEY=y
CONFIG_INET=y
CONFIG_IP_PNP=y
CONFIG_IP_PNP_DHCP=y
CONFIG_IP_PNP_BOOTP=y
CONFIG_IP_PNP_RARP=y
# CONFIG_INET_XFRM_MODE_TRANSPORT is not set
# CONFIG_INET_XFRM_MODE_TUNNEL is not set
# CONFIG_INET_XFRM_MODE_BEET is not set
# CONFIG_INET_LRO is not set
# CONFIG_IPV6 is not set
# CONFIG_WIRELESS is not set
CONFIG_DEVTMPFS=y
CONFIG_DEVTMPFS_MOUNT=y
CONFIG_BLK_DEV_LOOP=y
CONFIG_BLK_DEV_RAM=y
CONFIG_BLK_DEV_RAM_COUNT=1
CONFIG_BLK_DEV_RAM_SIZE=8192
CONFIG_NETDEVICES=y
CONFIG_PHYLIB=y
CONFIG_MARVELL_PHY=y
CONFIG_MICREL_PHY=y
CONFIG_MDIO_BITBANG=y
CONFIG_PPP=y
CONFIG_PPP_BSDCOMP=y
CONFIG_PPP_DEFLATE=y
CONFIG_PPP_ASYNC=y
CONFIG_PPP_SYNC_TTY=y
CONFIG_SLIP=y
CONFIG_SLIP_COMPRESSED=y
# CONFIG_WLAN is not set
# CONFIG_INPUT_MOUSEDEV is not set
# CONFIG_INPUT_MOUSE is not set
# CONFIG_SERIO_I8042 is not set
# CONFIG_SERIO_SERPORT is not set
# CONFIG_CONSOLE_TRANSLATIONS is not set
CONFIG_DEVPTS_MULTIPLE_INSTANCES=y
# CONFIG_DEVKMEM is not set
CONFIG_SERIAL_MILKYMIST=y
CONFIG_SERIAL_MILKYMIST_CONSOLE=y
# CONFIG_HW_RANDOM is not set
# CONFIG_HWMON is not set
# CONFIG_USB_SUPPORT is not set
CONFIG_EXT2_FS=y
CONFIG_MSDOS_FS=y
CONFIG_VFAT_FS=y
CONFIG_CRAMFS=y
CONFIG_ROMFS_FS=y
# CONFIG_NETWORK_FILESYSTEMS is not set
CONFIG_NLS_CODEPAGE_437=y
CONFIG_NLS_ISO8859_1=y
# CONFIG_SCHED_DEBUG is not set
# CONFIG_DEBUG_BUGVERBOSE is not set
CONFIG_DEBUG_INFO=y
# CONFIG_CRYPTO_ANSI_CPRNG is not set
# CONFIG_CRYPTO_HW is not set
```

## sound/soc/milkymist/Kconfig
```kconfig
config SND_MILKYMIST_SOC
	tristate "SoC Audio for the Milkymist chips"
	select AC97_BUS
	select SND_SOC_AC97_BUS
	depends on PLAT_MILKYMIST
 
config SND_MILKYMIST_SOC_MM1
	tristate "SoC Audio support for Milkymist One and ML401"
	depends on SND_MILKYMIST_SOC && BOARD_XILINX_ML401
	select SND_SOC_LM4550
	help
	  Say Y if you want to add support for SoC audio on Milkymist One and ML401.
```
